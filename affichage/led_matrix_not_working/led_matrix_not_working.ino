//We always have to include the library
#include "LedControl.h"

/*
 Now we need a LedControl to work with.
 ***** These pin numbers will probably not work with your hardware *****
 pin 12 is connected to the DataIn 
 pin 11 is connected to the CLK 
 pin 10 is connected to LOAD 
 We have only a single MAX72XX.
 */
LedControl lc=LedControl(12,11,10,1);


const int clockPin = 11;
const int dataPin = 12;
const int latchPin = 10;

byte arrow[8]={
  0x18,0x3C,0x66,0xDB,0x18,0x18,0x18,0x18};
byte displayBuffer[8]= {
  0};
int fontDefinitions[475] = {
  0x00,0x00,0x00,0x00,0x00,/*space*/ // is 32 in ASCII
  0x00,0xF6,0xF6,0x00,0x00,/*!*/
  0x00,0xE0,0x00,0xE0,0x00,/*"*/
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  0x00,0x00,0x06,0x06,0x00,/*.*/
  0x02,0x0C,0x10,0x60,0x80,/*/*/
  0x7C,0x8A,0x92,0xA2,0x7C,/*0*/
  0x00,0x42,0xFE,0x02,0x00,/*1*/
  0x42,0x86,0x8A,0x92,0x62,/*2*/
  0x44,0x82,0x92,0x92,0x6C,/*3*/
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  0x00,0x10,0x6C,0x82,0x82,/*{*/
  //0x00,0x00,0xFF,0x00,0x00,/*|*/
  0x04,0x02,0xFF,0x02,0x04,/*|, arrow*/
  0x82,0x82,0x6C,0x10,0x00,/*}*/
  0x08,0x10,0x18,0x08,0x10/*~*/
};

void setup() {
  pinMode(clockPin, OUTPUT);
  pinMode(dataPin, OUTPUT);
  pinMode(latchPin, OUTPUT);
  
  /*
   The MAX72XX is in power-saving mode on startup,
   we have to do a wakeup call
   */
  lc.shutdown(0,false);
  /* Set the brightness to a medium values */
  lc.setIntensity(0,3);
  /* and clear the display */
  lc.clearDisplay(0);  
}

void loop() {
  displayString("This is a scrolling LED matrix display. You can easily make your own! ", 70);
}

void scrollBufferLeft() {
  for(int i=7; i>=0; i--) {
    displayBuffer[i+1] = displayBuffer[i];
  }
}

void addCharSliceToBuffer(char c, byte pos) {
  displayBuffer[0] = fontDefinitions[((c - 32) * 5) + pos];
}

void displayString(char * stringToDisplay, byte stringLength) {
  for(int k = 0; k < stringLength; k++) {
    for(int j = 0; j < 5; j++) {
      addCharSliceToBuffer(stringToDisplay[k], j);
      for(int i=0; i<20; i++) drawImage(displayBuffer);
      scrollBufferLeft();
    }
    addCharSliceToBuffer(' ', 0);
    for(int i=0; i<20; i++) drawImage(displayBuffer);
    scrollBufferLeft();
  }
}

void drawImage(byte * matrix) {
  for(int i=0; i<8; i++) {
    for(int j=0; j<8; j++) {
      digitalWrite(clockPin, LOW);
      digitalWrite(dataPin, (matrix[i]) & (1<<j) );
      digitalWrite(clockPin, HIGH);
    }
    for(int j=7; j>=0; j--) {
      digitalWrite(clockPin, LOW);
      digitalWrite(dataPin, (~(1<<i)) & (1<<j) );
      digitalWrite(clockPin, HIGH);
    }

    digitalWrite(latchPin,LOW);
    digitalWrite(latchPin,HIGH);
  }
} 

